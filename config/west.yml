## config/west.yml
```yaml
manifest:
  remotes:
    - name: zmkfirmware
      url-base: https://github.com/zmkfirmware
    - name: siddhantac
      url-base: https://github.com/siddhantac
  projects:
    - name: zmk
      remote: zmkfirmware
      revision: v0.3
      import: app/west.yml
    - name: nice-view
      remote: siddhantac
      revision: main
  self:
    path: config
```
